#define ZMK_BASE_LAYER(name, LT, RT, LM, RM, LB, RB, LH, RH)                   \
    ZMK_LAYER(                                                                 \
        name,                                                                  \
                 LT RT                                                         \
                 LM RM                                                         \
                 LB RB                                                         \
        &kp LGUI LH RH &smart_mouse                                            \
    )

/* map Corne's extra keys */
#define X_LT &none
#define X_LM &none
#define X_LB &none
#define X_LH &none
#define X_RT &none
#define X_RM &none
#define X_RB &none
#define X_RH &none

#define CONFIG_WIRELESS 1

#include "zmk-helpers/key-labels/42.h"
#include "base.keymap" 

/{ chosen { zmk,physical-layout = &foostan_corne_5col_layout; }; };
